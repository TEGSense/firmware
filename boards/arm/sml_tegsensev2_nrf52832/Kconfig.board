## boards/arm/sml_tegsensev2_nrf52832/Kconfig.board
```kconfig
config BOARD_SML_TEGSENSEV2_NRF52832
	bool "SML TEGSense-v2"
	depends on SOC_NRF52832_QFAA

config BOARD_ENABLE_DCDC
	bool "DCDC mode"
	select SOC_DCDC_NRF52X
	default y
	depends on BOARD_SML_TEGSENSEV2_NRF52832
```

## boards/arm/sml_tegsensev2_nrf52832/Kconfig.defconfig
```kconfig
if BOARD_SML_TEGSENSEV2_NRF52832

config BOARD
	default "sml_tegsensev2_nrf52832"

config BT_CTLR
   default BT

endif
```

## boards/arm/sml_tegsensev2_nrf52832/sml_tegsensev2_nrf52832_defconfig
```kconfig
CONFIG_SOC_SERIES_NRF52X=y
CONFIG_SOC_NRF52832_QFAA=y
CONFIG_BOARD_SML_TEGSENSEV2_NRF52832=y

# Enable MPU
CONFIG_ARM_MPU=y

# Enable hardware stack protection
CONFIG_HW_STACK_PROTECTION=y

# enable GPIO
CONFIG_GPIO=y

# additional board options
CONFIG_GPIO_AS_PINRESET=n
```
